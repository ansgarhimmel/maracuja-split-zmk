## config/boards/shields/maracuja/Kconfig.defconfig
```kconfig
if SHIELD_MARACUJA_LEFT

config ZMK_KEYBOARD_NAME
  default "Maracuja Split BLE"

config ZMK_SPLIT_ROLE_CENTRAL
  default y

endif

if SHIELD_MARACUJA_LEFT || SHIELD_MARACUJA_RIGHT
config ZMK_SPLIT
  default y

endif
```

## config/boards/shields/maracuja/Kconfig.shield
```kconfig
config SHIELD_MARACUJA_LEFT
    def_bool $(shields_list_contains,maracuja_left)

config SHIELD_MARACUJA_RIGHT
    def_bool $(shields_list_contains,maracuja_right)
```
